// SPDX-License-Identifier: (GPL-2.0+ OR MIT)
/*
 * Copyright (c) 2020 Rockchip Electronics Co., Ltd.
 *
 */

#define ATK_LCD_TYPE_MIPI_1080P
#define ATK_LCD_TYPE_HDMI

#include "rk3568-atk-evb1-ddr4-v10.dtsi"
#include "rk3568-android.dtsi"
#include "rk3568-lcds.dtsi"

&bt_sco {
	status = "okay";
};

&bt_sound {
	status = "okay";
};

&i2s3_2ch {
	status = "okay";
};
